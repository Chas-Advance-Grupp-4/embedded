## controlunit/test_runner/sdkconfig.defaults
```kconfig
CONFIG_UNIT_TEST_ENABLED=y
CONFIG_IDF_TARGET="esp32s3"
CONFIG_LOG_DEFAULT_LEVEL=3
CONFIG_USB_CDC_ENABLED=y
CONFIG_ESP_CONSOLE_USB_CDC=y
CONFIG_ESP_CONSOLE_USB_CDC_LOG=y
CONFIG_ESP_CONSOLE_USB_CDC_LOG_LEVEL=3
```
